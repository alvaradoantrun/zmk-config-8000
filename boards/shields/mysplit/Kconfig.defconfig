## boards/shields/mysplit/Kconfig.defconfig
```kconfig
if SHIELD_MYSPLIT_RIGHT
config ZMK_KEYBOARD_NAME
    default "MySplit"
config ZMK_SPLIT_ROLE_CENTRAL
    default y
endif

if SHIELD_MYSPLIT_LEFT || SHIELD_MYSPLIT_RIGHT
config ZMK_SPLIT
    default y
endif
```

## boards/shields/mysplit/Kconfig.shield
```kconfig
config SHIELD_MYSPLIT_LEFT
    def_bool $(shields_list_contains,mysplit_left)

config SHIELD_MYSPLIT_RIGHT
    def_bool $(shields_list_contains,mysplit_right)
```

## west.yml
```yaml
manifest:
  remotes:
    - name: zmkfirmware
      url-base: https://github.com/zmkfirmware
  projects:
    - name: zmk
      remote: zmkfirmware
      revision: main
      import:
        path-prefix: app
        file: west.yml
  self:
    path: config
```
